## package/bt_service/Config.in
```kconfig
config BR2_PACKAGE_BT_SERVICE
	bool "bt_service"
	help
	  The bluetooth service.
```

## package/fcs96xfmac/Config.in
```kconfig
config BR2_PACKAGE_FCS96XFMAC
	bool "wlan and BT from FCS96XFMAC.ex:FCS963NLP/FCS962NLP"
```

## package/ingenic/Config.in
```kconfig
menu "Ingenic"

	source "package/ingenic/system_start_config/Config.in"
	source "package/ingenic/bcm43438_firmware/Config.in"
    source "package/ingenic/morse6108_firmware/Config.in"
    source "package/ingenic/bcm43012_firmware/Config.in"
    source "package/ingenic/bcm55512_firmware/Config.in"
    source "package/ingenic/fcs96xfmac_firmware/Config.in"
endmenu
```

## package/ingenic/bcm43012_firmware/Config.in
```kconfig
config BR2_PACKAGE_BCM43012_FIRMWARE
	bool "bcm43012-firmware"
	select BR2_PACKAGE_UTIL_LINUX_RFKILL
	help
	  copy bcm43012 firmware to system


config BCM43012_FIRMWARE_FILE_PATH
	depends on BR2_PACKAGE_BCM43012_FIRMWARE
	string "bcm43012 firmware path"
	default "/lib/firmware/wifi_bcm"
```

## package/ingenic/bcm43438_firmware/Config.in
```kconfig
config BR2_PACKAGE_BCM43438_FIRMWARE
	bool "bcm43438-firmware"
	select BR2_PACKAGE_UTIL_LINUX_RFKILL
	help
	  copy bcm43438 firmware to system

choice
	prompt "bluetooth protocol stack select"
	depends on BR2_PACKAGE_BCM43438_FIRMWARE
	default BCM43438_FIRMWARE_BT_PROTOCOL_BSA

config BCM43438_FIRMWARE_BT_PROTOCOL_BLUEZ
	bool "bluez"

config BCM43438_FIRMWARE_BT_PROTOCOL_BSA
	bool "bsa"

endchoice

config BCM43438_FIRMWARE_FILE_PATH
	depends on BR2_PACKAGE_BCM43438_FIRMWARE
	string "bcm43438 firmware path"
	default "/lib/firmware"

config BCM43438_FIRMWARE_BT_UART_DEV_PATH
	depends on BR2_PACKAGE_BCM43438_FIRMWARE
	string "bcm43438 bt uart device path"
	default "/dev/ttyS0"
```

## package/ingenic/bcm55512_firmware/Config.in
```kconfig
config BR2_PACKAGE_BCM55512_FIRMWARE
	bool "bcm55512-firmware"
	select BR2_PACKAGE_UTIL_LINUX_RFKILL
	help
	  copy bcm55512 firmware to system

choice
	prompt "bluetooth protocol stack select"
	depends on BR2_PACKAGE_BCM55512_FIRMWARE
	default BCM55512_FIRMWARE_BT_PROTOCOL_BTSTACK

config BCM55512_FIRMWARE_BT_PROTOCOL_BLUEZ
	bool "bluez"

config BCM55512_FIRMWARE_BT_PROTOCOL_BTSTACK
	bool "btstack"

endchoice

config BCM55512_FIRMWARE_FILE_PATH
	depends on BR2_PACKAGE_BCM55512_FIRMWARE
	string "bcm55512 firmware path"
	default "/lib/firmware"

config BCM55512_FIRMWARE_BT_UART_DEV_PATH
	depends on BR2_PACKAGE_BCM55512_FIRMWARE
	string "bcm55512 bt uart device path"
	default "/dev/ttyS0"
```

## package/ingenic/fcs96xfmac_firmware/Config.in
```kconfig
config BR2_PACKAGE_FCS96XFMAC_FIRMWARE
	bool "fcs96xfmac-firmware"
	select BR2_PACKAGE_UTIL_LINUX_RFKILL
	help
	  copy fcs96xfmac firmware to system

config FCS96XFMAC_FIRMWARE_FILE_PATH
    depends on BR2_PACKAGE_FCS96XFMAC_FIRMWARE
	string "fcs96xfmac firmware path"
	default "/lib/firmware/cypress"
```

## package/ingenic/morse6108_firmware/Config.in
```kconfig
config BR2_PACKAGE_MORSE6108_FIRMWARE
	bool "morse6108-firmware"
	select BR2_PACKAGE_UTIL_LINUX_RFKILL
	help
	  copy morse6108 firmware to system

config MORSE6108_FIRMWARE_FILE_PATH
    depends on BR2_PACKAGE_MORSE6108_FIRMWARE
	string "morse6108 firmware path"
	default "/lib/firmware"
```

## package/ingenic/system_start_config/Config.in
```kconfig
menuconfig BR2_PACKAGE_SYSTEM_START_CONFIG
	bool "system start config"
	help
	  The ingenic customize for your system

if BR2_PACKAGE_SYSTEM_START_CONFIG

config SYSTEM_START_CONFIG_ADB_SERVICE
	bool "enable adb service"

endif # BR2_PACKAGE_SYSTEM_START_CONFIG
```

## package/libzint/Config.in
```kconfig
config BR2_PACKAGE_LIBZINT
	bool "libzint"
	select BR2_PACKAGE_LIBPNG
	help
	  A barcode generator and library.
	  http://www.zint.org.uk
	  
```

## package/morse-ctrl/Config.in
```kconfig
config BR2_PACKAGE_MORSE_CTRL
	bool "morse-ctrl"
	#depends on BR2_PACKAGE_MORSE_MOD
	help
		Morse Micro control tools.

		http://www.morsemicro.com/

config BR2_PACKAGE_MORSE_CTRL_VERSION
	string "morsectrl version"
	default "rel_1_8_1_2023_May_25"
	depends on BR2_PACKAGE_MORSE_CTRL
	help
		Morse Micro control tools version

config BR2_PACKAGE_MORSE_CTRL_TRANS_NL80211
	bool "Transport - nl80211"
	default y
	depends on BR2_PACKAGE_MORSE_CTRL
	select BR2_PACKAGE_LIBNL
	help
		Allows the use of the NL80211 (netlink) transport

config BR2_PACKAGE_MORSE_CTRL_TRANS_FTDI_SPI
	bool "Transport - ftdi spi"
	default y
	depends on BR2_PACKAGE_MORSE_CTRL
	help
		Allows the use of the FTDI SPI (SDIO over SPI) transport

config BR2_PACKAGE_MORSE_CTRL_SANITISE
	bool "sanitise"
	depends on BR2_PACKAGE_MORSE_CTRL
	help
		Sanitises morse-ctrl source code
```

## package/wl/Config.in
```kconfig
config BR2_PACKAGE_WL
	bool "wl"
	help
		keiiot wireless control tools.

config BR2_PACKAGE_WL_VERSION
	string "wl version"
	default "0704"
	depends on BR2_PACKAGE_WL
	help
		keiiot wireless control tools version
```

## package/wl_fmac_mips32_static/Config.in
```kconfig
config BR2_PACKAGE_WL_FMAC_MIPS32_STATIC
	bool "wl_FMAC_MIPS32_static"
	help
		broadcom wireless control tools.

config BR2_PACKAGE_WL_FMAC_MIPS32_STATIC_VERSION
	string "wl version"
	default "1118"
	depends on BR2_PACKAGE_WL_FMAC_MIPS32_STATIC
	help
		broadcom wireless control tools version
```

## package/wpa_supplicant_s1g/Config.in
```kconfig
config BR2_PACKAGE_WPA_SUPPLICANT_S1G
	bool "wpa_supplicant_s1g"
	depends on BR2_USE_MMU # fork()
	help
	  WPA supplicant for secure wireless networks
	  (Added S1G Support)
	  http://w1.fi/wpa_supplicant/

if BR2_PACKAGE_WPA_SUPPLICANT_S1G

config BR2_PACKAGE_WPA_SUPPLICANT_S1G_NL80211
	bool "Enable nl80211 support"
	default y
	depends on BR2_TOOLCHAIN_HAS_THREADS # libnl
	select BR2_PACKAGE_LIBNL
	help
	  Enable support for nl80211.  This is the current wireless
	  API for Linux, supported by all wireless drivers in vanilla
	  Linux, but may not be supported by some out-of-tree Linux
	  wireless drivers.  wpa_supplicant will still fall back to
	  using the Wireless Extensions (wext) API with these drivers.

	  If this option is disabled, then only the deprecated wext
	  API will be supported, with far less features.  Linux may
	  supports using wext with modern drivers using a
	  compatibility layer, but it must be enabled in the kernel
	  configuration.

comment "nl80211 support needs a toolchain w/ threads"
	depends on !BR2_TOOLCHAIN_HAS_THREADS

config BR2_PACKAGE_WPA_SUPPLICANT_S1G_AP_SUPPORT
	bool "Enable AP mode"
	depends on BR2_PACKAGE_WPA_SUPPLICANT_S1G_NL80211
	help
	  With this option enabled, wpa_supplicant can act as an
	  access point much like hostapd does with a limited feature
	  set.  This links in parts of hostapd functionality into
	  wpa_supplicant, making it bigger but dispensing the need for
	  a separate hostapd binary in some applications hence being
	  smaller overall.

config BR2_PACKAGE_WPA_SUPPLICANT_S1G_DPP
	bool "Enable Device Provisioning Protocol"
	depends on BR2_PACKAGE_WPA_SUPPLICANT_S1G_WPA3
	help
	  Enable Device Provisioning Protocol

config BR2_PACKAGE_WPA_SUPPLICANT_S1G_WIFI_DISPLAY
	bool "Enable Wi-Fi Display"
	depends on BR2_PACKAGE_WPA_SUPPLICANT_S1G_AP_SUPPORT
	help
	  Enable support for Wi-Fi Display

config BR2_PACKAGE_WPA_SUPPLICANT_S1G_MESH_NETWORKING
	bool "Enable mesh networking"
	depends on BR2_PACKAGE_WPA_SUPPLICANT_S1G_AP_SUPPORT
	select BR2_PACKAGE_OPENSSL
	select BR2_PACKAGE_OPENSSL_FORCE_LIBOPENSSL
	help
	  Enable support for open and secured mesh networking
	  (IEEE 802.11s)

config BR2_PACKAGE_WPA_SUPPLICANT_S1G_AUTOSCAN
	bool "Enable autoscan"
	help
	  Enable support for the autoscan feature (allow periodic scan)

config BR2_PACKAGE_WPA_SUPPLICANT_S1G_EAP
	bool "Enable EAP"
	help
	  Enable support for EAP.

config BR2_PACKAGE_WPA_SUPPLICANT_S1G_HOTSPOT
	bool "Enable HS20"
	help
	  Enable Hotspot 2.0 and IEEE 802.11u interworking
	  functionality.

config BR2_PACKAGE_WPA_SUPPLICANT_S1G_DEBUG_SYSLOG
	bool "Enable syslog support"
	help
	  Enable support for sending debug messages to syslog.

config BR2_PACKAGE_WPA_SUPPLICANT_S1G_WPS
	bool "Enable WPS"
	help
	  Enable support for Wi-Fi Protected Setup (WPS).

config BR2_PACKAGE_WPA_SUPPLICANT_S1G_WPA3
	bool "Enable WPA3 support"
	select BR2_PACKAGE_OPENSSL
	select BR2_PACKAGE_OPENSSL_FORCE_LIBOPENSSL
	help
	  Enable WPA3 support including OWE, SAE, DPP

config BR2_PACKAGE_WPA_SUPPLICANT_S1G_CLI
	bool "Install wpa_cli binary"
	help
	  Install wpa_cli command line utility

config BR2_PACKAGE_WPA_SUPPLICANT_S1G_WPA_CLIENT_SO
	bool "Install wpa_client shared library"
	depends on !BR2_STATIC_LIBS
	help
	  Install libwpa_client.so.

comment "wpa_client library needs a toolchain w/ dynamic library"
	depends on BR2_STATIC_LIBS

config BR2_PACKAGE_WPA_SUPPLICANT_S1G_PASSPHRASE
	bool "Install wpa_passphrase binary"
	help
	  Install wpa_passphrase command line utility.

config BR2_PACKAGE_WPA_SUPPLICANT_S1G_DBUS
	bool "Enable support for the DBus control interface"
	depends on BR2_TOOLCHAIN_HAS_THREADS # dbus
	select BR2_PACKAGE_DBUS
	help
	  Enable support for the DBus control interface.

comment "dbus support needs a toolchain w/ threads"
	depends on !BR2_TOOLCHAIN_HAS_THREADS

config BR2_PACKAGE_WPA_SUPPLICANT_S1G_DBUS_INTROSPECTION
	bool "Introspection support"
	depends on BR2_PACKAGE_WPA_SUPPLICANT_S1G_DBUS
	help
	  Add introspection support for new DBus control interface.

config BR2_PACKAGE_WPA_SUPPLICANT_S1G_VERSION
    	string "wpa_supplicant S1G version"
        default "rel_1_6_1_2022_Nov_08"
    	depends on BR2_PACKAGE_WPA_SUPPLICANT_S1G
    	help
          wpa_supplicant S1G version

config BR2_PACKAGE_WPA_SUPPLICANT_S1G_SITE
        string "wpa_supplicant S1G site address"
        default "ssh://git@bitbucket.org/morsemicro/hostap.git"
        depends on BR2_PACKAGE_WPA_SUPPLICANT_S1G
        help
          wpa_supplicant S1G site address

config BR2_PACKAGE_SUNMI_ADD
        bool "Merge the patch added by sunmi"
        #string "S1G adaptation information, from snumi"
        depends on BR2_PACKAGE_WPA_SUPPLICANT_S1G
        help
          wpa_supplicant S1G information
endif
```
